## app_core/Kconfig
```kconfig
menu "App Manager"

config APP_MANAGER_LIFECYCLE_DEBUG_LOG
    bool "Enable lifecycle event debug logs"
    default n
    help
        Log START, MOUNT, RESUME, PAUSE, UNMOUNT, STOP, and NEW_INTENT
        lifecycle handler dispatches. Keep disabled in production to remove
        the event-name table, format strings, and per-dispatch logging cost.

config APP_MANAGER_MAX_RESIDENT_APPS
    int "Resident application capacity"
    range 1 16
    default 8

config APP_MANAGER_MAX_PAGE_INSTANCES
    int "Page instance capacity"
    range 1 32
    default 12

config APP_MANAGER_NAV_COMMAND_CAPACITY
    int "Navigation command capacity"
    range 1 64
    default 24

config APP_MANAGER_MAILBOX_CAPACITY
    int "Mailbox command capacity"
    range 1 64
    default 24

config APP_MANAGER_CONTROL_QUEUE_DEPTH
    int "App-control queue depth"
    range 1 64
    default 16

config APP_MANAGER_CONTROL_TASK_STACK
    int "App-control task stack size"
    range 2048 16384
    default 4096

config APP_MANAGER_LVGL_PARTIAL_BUFFER_HEIGHT
    int "LVGL partial draw buffer height"
    range 1 448
    default 60
    help
        Number of RGB565 display rows in each non-TE LVGL draw buffer.
        The display transport independently limits each SPI DMA submission.

config APP_MANAGER_LVGL_WORKER_STACK_SIZE
    int
    range 8192 32768
    default 32768 if LV_OS_NONE
    default 8192
    help
        Stack size of the esp_lvgl_adapter worker. Synchronous LVGL drawing
        executes FreeType rendering on this PSRAM-backed task, so LV_OS_NONE
        retains the conservative 32 KiB font-rendering budget.

choice APP_MANAGER_LVGL_WORKER_AFFINITY
    prompt "LVGL worker core affinity"
    default APP_MANAGER_LVGL_WORKER_AFFINITY_NO_AFFINITY
    help
        Select the core used by the esp_lvgl_adapter worker. Keep the default
        unless a product profile also isolates other project and system tasks.

config APP_MANAGER_LVGL_WORKER_AFFINITY_CPU0
    bool "CPU0"
    depends on !FREERTOS_UNICORE

config APP_MANAGER_LVGL_WORKER_AFFINITY_CPU1
    bool "CPU1"
    depends on !FREERTOS_UNICORE

config APP_MANAGER_LVGL_WORKER_AFFINITY_NO_AFFINITY
    bool "No affinity"

endchoice

config APP_MANAGER_LVGL_WORKER_CORE_ID
    int
    default 0 if APP_MANAGER_LVGL_WORKER_AFFINITY_CPU0
    default 1 if APP_MANAGER_LVGL_WORKER_AFFINITY_CPU1
    default -1

config APP_MANAGER_PRESENTATION_SNAPSHOT_ANIMATION
    bool "Enable full-resolution snapshot screen transitions"
    depends on SPIRAM
    default y
    select LV_USE_IMAGE
    select LV_USE_SNAPSHOT
    help
        Capture source and destination screens into two persistent RGB565
        PSRAM buffers, then animate their Image widgets. This avoids drawing
        the live screen trees during animated transitions at a cost of two
        full-screen snapshots. Native LVGL screen animations remain the
        automatic fallback when snapshot resources or capture are unavailable.

config APP_MANAGER_DISPLAY_DIAGNOSTICS
    bool "Enable display performance diagnostics"
    depends on SPIRAM
    default n
    select ESP_LVGL_ADAPTER_ENABLE_FPS_STATS
    help
        Periodically log display FPS and DMA/internal plus PSRAM heap
        availability. This creates one low-priority PSRAM-stack task and is
        intended for on-device performance validation.

endmenu
```
